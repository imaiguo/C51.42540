/*************************************************************************************
*  标题:  步进电机试验二															 *
* 																					 *
*    通过本例程了解步进马达使用及驱动程序编写										 *
*;   单双八拍工作方式：                                                           	 *
*;   A-AB-B-BC-C-CD-D-DA     								 						 *                      								 *
**************************************************************************************/   
//接线方法：请你一定要看，步进电机杜邦线接方法 步进电机模块上“-”接到开发板上的GND “+接VCC
//IN1~IN4 分别接到P1.0~P1.3” 
 

#include "reg52.h"
unsigned char code RUN[8]={0xfe,0xfc,0xfd,0xf9,0xfb,0xf3,0xf7,0xf6};  //步进电机相序表
void delay(unsigned int t);


//步进电机驱动
void  motor_ffw()
 { 
   unsigned char i;
  
      for (i=0; i<8; i++)       //8拍
        {
          P1 = RUN[i];     //取数据
          delay(2);             //调节转速
        }
     } 

/******延时函数****************/
void delay(unsigned int t)
{                           
   unsigned int k;
   while(t--)
   {
     for(k=0; k<60; k++)//用for的空循环延长程序的执行时间
     { }
   }
}


main() 
{ 
     while(1)       
     {
	  motor_ffw(); 
	 }
}

