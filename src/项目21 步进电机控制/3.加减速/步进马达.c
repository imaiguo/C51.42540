/*************************************************************************************
*  标题:  步进电机试验三（加减速运行）												 *
* 																					 *
*    通过本例程了解步进马达使用及驱动程序编写										 *
*;   单双八拍工作方式：                                                          	 *
*;   A-AB-B-BC-C-CD-D-DA      								 *
*                     	                                                       		 *														 *
**************************************************************************************/
//接线方法：请你一定要看，步进电机杜邦线接方法 步进电机模块上“-”接到开发板上的GND “+接VCC
//IN1~IN4 分别接到P1.0~P1.3”
 
 #include "reg52.h"

 void delay();

 //Motor
sbit F1 = P1^0;
sbit F2 = P1^1;
sbit F3 = P1^2;
sbit F4 = P1^3;

unsigned char code FFW[8]={0xfe,0xfc,0xfd,0xf9,0xfb,0xf3,0xf7,0xf6}; //反转
unsigned char code FFZ[8]={0xf6,0xf7,0xf3,0xfb,0xf9,0xfd,0xfc,0xfe}; //正转
unsigned int  K, rate;


/**********************************************************
*														  *
*                 步进电机驱动							  *
***********************************************************/
void  motor_ffw()
 { 
   unsigned char i;

      for (i=0; i<8; i++)
        {
          P1 = FFW[i]&0x1f;  //取数据
		
          delay();           //调节转速
        }
     } 

/********************************************
	 延时程序
*********************************************/

 void delay()   
{                           
   unsigned int k,t;
    t=rate;
   while(t--)
   {
     for(k=0; k<200; k++)
     { }
   }
}


/********************************************************
*                                                       
*步进电机运行                                               
*                                                      
*********************************************************/
void  motor_turn()
{ 
   unsigned char x;
   rate=0x09;
   x=0x40;
   do
     {
	  motor_ffw();          //加速
      rate--;
	 }while(rate!=0x01);
   do
     { 	   
	   motor_ffw();        //匀速
	   x--;
	 }while(x!=0x01);
	 
   do
     {
	  motor_ffw();         //减速
      rate++;
	 }while(rate!=0x09);    
}

main() 
{ 
    while(1)
	{
	 motor_turn();
	}
}

